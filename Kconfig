## Kconfig
```kconfig
# Empty

config TFLITE_SUBPROJECT
    bool "Tensorflow Lite subproject."
    help
      Tensorflow Lite subproject.
```

## west.yml
```yaml
manifest:
  self:
    path: tflite_sub_proj

  remotes:
    - name: ncs
      url-base: git@github.com:nrfconnect
    # - name: zephyr
    #   url-base: git@github.com:zephyrproject-rtos

  projects: 
    # nordic toolchain added to this project (includes zephyr)
    - name: sdk-nrf
      remote: ncs
      path: nrf
      revision: v2.4.0
      # revision: main
      import: true
      clone-depth: 1
    # # tflite
    # - name: tflite_micro
    #   remote: zephyr
    #   repo-path: tflite-micro
    #   path: modules/lib/tflite_micro
    #   revision: 9156d050927012da87079064db59d07f03b8baf6
```
